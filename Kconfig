## Kconfig
```kconfig
if TARGET_VDT6010

config SYS_BOARD
	default "vdt6010"

config SYS_VENDOR
	default "datarespons"

config SYS_CONFIG_NAME
	default "vdt6010"

config PMIC_I2C_BUS
	int
	default 0

config FACTORY_BOOT
	bool "Factory boot mode"
	default n
	help
	  Enables the factory installation boot mode

config LOGLEVEL
	int "Kernel loglevel"
	default 4

config BOOT_USB_INITRD
	bool "Only allow usb boot from signed initrd"
	default n

endif
```
